## linux-4.14.13.bs_pk/arch/arm/mach-anusoc/Kconfig
```kconfig
#
# SPEAr Platform configuration file
#

config MACH_TYPE_ANUSOC
	bool "ANUSOC from ANURAG"
	depends on ARCH_MULTI_V7
	help
	  Supports ANUWAP board configured via the device-tree
```
